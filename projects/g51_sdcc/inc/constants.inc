TAB			.equ		0x09
NULL 		.equ		0x00 
BS 			.equ		0x08
SPC			.equ		0x20
CR			.equ		0x0a
LF			.equ		0x0d
DEL			.equ		0x7f

.globl title_str
.globl newline_str
.globl command_prompt_str
.globl help_table
.globl app_table
.globl p0_txt
.globl p1_txt
.globl p2_txt
.globl p3_txt
.globl pcon_txt
.globl psw_txt
.globl ip_txt
.globl ie_txt
.globl tcon_txt
.globl tmod_txt
.globl tl0_txt
.globl tl1_txt
.globl th0_txt
.globl th1_txt
.globl scon_txt
.globl sbuf_txt
.globl acc_txt
.globl b_txt
.globl help_txt
.globl ls_txt
.globl peek_txt
.globl poke_txt
.globl clear_txt
.globl reset_txt
.globl write_txt
.globl dump_txt
.globl fill_txt
.globl copy_txt
.globl goto_txt
.globl iram_txt
.globl sfr_txt
.globl msg_err
